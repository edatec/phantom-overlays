/dts-v1/;
/plugin/;

/ {
	compatible = "phantom", "amlogic, sc2";

	fragment@0 {
		target = <&i2c0>;
		__overlay__ {
			#address-cells = <1>;
			#size-cells = <0>;
			status = "okay";

			sc16is752: sc16is752@48 {
				compatible = "nxp,sc16is752";
				reg = <0x48>; /* i2c address */
				clocks = <&sc16is752_clk>;
				interrupt-parent = <&gpio_intc>;
				interrupts = <72 2>;
				gpio-controller;
				#gpio-cells = <2>;
				i2c-max-frequency = <400000>;
			};
		};
	};

	fragment@1 {
		target-path = "/";
		__overlay__ {
			sc16is752_clk: sc16is752_i2c_clk {
				compatible = "fixed-clock";
				#clock-cells = <0>;
				clock-frequency = <14745600>;
			};
		};
	};

	__overrides__ {
		int_pin = <&sc16is752>,"interrupts:0";
		addr = <&sc16is752>,"reg:0";
		xtal = <&sc16is752_clk>,"clock-frequency:0";
	};
};
